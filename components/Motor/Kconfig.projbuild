## components/Motor/Kconfig.projbuild
```kconfig
menu "MQTT Telemetry Configuration"

    config BROKER_URI
        string "Broker URL"
        default "mqtts://DRIVE-90531.corp.breckstampede.org:8883"
        help
            URL of an mqtt broker which this example connects to.

    config BROKER_BIN_SIZE_TO_SEND
        # This option is not visible and is used only to set parameters for example tests
        # Here we configure the data size to send and to be expected in the python script
        int
        default 20000
endmenu

menu "WiFi Midway Configuration"

    config ESP_WIFI_SSID
        string "WiFi SSID"
        default "myssid"
        help
            SSID (network name) for the example to connect to.

    config ESP_WIFI_PASSWORD
        string "WiFi Password"
        default "mypassword"
        help
            WiFi password (WPA or WPA2) for the example to use.
    
    
endmenu
```

## components/VL53L0X/Kconfig.projbuild
```kconfig
menu "V53L0X Sensor Configuration"

    config VL53L0X_DEBUG
        bool "Enable Debug Logging"
        default y
        help
            Enable debug logging for the VL53L0X sensor.

endmenu
```
